## boards/shields/corne_left/Kconfig.defconfig
```kconfig
if SHIELD_CORNE_LEFT

config hwcorne 
    string
    default "corne_left"

endif
```

## boards/shields/corne_right/Kconfig.defconfig
```kconfig
if SHIELD_CORNE_RIGHT

config hwcorne 
    string
    default "corne_right"

endif
```
